## app/boards/arm/demomacropad/Kconfig.board
```kconfig
# Copyright (c) 2021 Nick Winans
# SPDX-License-Identifier: MIT

config BOARD_DEMOMACROPAD
    bool "demomacropad"
    depends on SOC_NRF52840_QIAA
```
